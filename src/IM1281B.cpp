#include "IM1281B.h"


// #define DEBUG   // 选择是否输出调试信息，注释掉此行则不会输出调试信息
#ifdef DEBUG
#define DEBUG_PRINT(x) Serial.print(x)
#define DEBUG_PRINTLN(x) Serial.println(x)
#else
   #define DEBUG_PRINT(x)
   #define DEBUG_PRINTLN(x)
#endif


static const uint8_t aucCRCHi[] = {
    0x00, 0xC1, 0x81, 0x40, 0x01, 0xC0, 0x80, 0x41, 0x01, 0xC0, 0x80, 0x41,
    0x00, 0xC1, 0x81, 0x40, 0x01, 0xC0, 0x80, 0x41, 0x00, 0xC1, 0x81, 0x40,
    0x00, 0xC1, 0x81, 0x40, 0x01, 0xC0, 0x80, 0x41, 0x01, 0xC0, 0x80, 0x41,
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    0x00, 0xC1, 0x81, 0x40
};

static const uint8_t aucCRCLo[] = {
    0x00, 0xC0, 0xC1, 0x01, 0xC3, 0x03, 0x02, 0xC2, 0xC6, 0x06, 0x07, 0xC7,
    0x05, 0xC5, 0xC4, 0x04, 0xCC, 0x0C, 0x0D, 0xCD, 0x0F, 0xCF, 0xCE, 0x0E,
    0x0A, 0xCA, 0xCB, 0x0B, 0xC9, 0x09, 0x08, 0xC8, 0xD8, 0x18, 0x19, 0xD9,
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    0x41, 0x81, 0x80, 0x40
};


#if defined(__AVR__) || defined(ESP8266) || defined(FREEDOM_E300_HIFIVE1)
IM1281B::IM1281B(SoftwareSerial *ss, uint16_t baudrate) {
  hwSerial = NULL;
  swSerial = ss;
  mySerial = swSerial;
  begin(baudrate);
}
#endif

IM1281B::IM1281B(HardwareSerial *hs, uint16_t baudrate) {
#if defined(__AVR__) || defined(ESP8266) || defined(FREEDOM_E300_HIFIVE1)
  swSerial = NULL;
#endif
  hwSerial = hs;
  mySerial = hwSerial;
  begin(baudrate);
}


IM1281B::IM1281B(Stream *serial, uint16_t baudrate) {
  hwSerial = NULL;
#if defined(__AVR__) || defined(ESP8266) || defined(FREEDOM_E300_HIFIVE1)
  swSerial = NULL;
#endif
  mySerial = serial;
  begin(baudrate);
}


void IM1281B::begin(uint16_t baudrate)
{
    delay(1000); // one second delay to let the sensor 'boot up'
  if (hwSerial)
    hwSerial->begin(baudrate);
  #if defined(__AVR__) || defined(ESP8266) || defined(FREEDOM_E300_HIFIVE1)
  if (swSerial)
    swSerial->begin(baudrate);
  #endif
}

void IM1281B::read_data_message()
{
  for (size_t i = 0; i < 8; i++)
    mySerial->write(Tx_Buffer[i]);
  DEBUG_PRINTLN("read_data_message send!");
}

bool IM1281B::get_CMD_message()
{
  uint16_t i = 0;
  uint16_t timer = 0;
  while(true)
    {
      if(!mySerial->available())
      {
          delay(10);
          timer++;
          if(timer >= 10)
          {
              DEBUG_PRINTLN("");
              DEBUG_PRINTLN("Date Receive Over.");
              cmdLenth = i;
              return true;
          }       
      }
      if (mySerial->available()){
        Rx_Buffer[i] = uint8_t(mySerial->read());
        i++;
      }
    }
}


bool IM1281B::analysis_data()
{
  DEBUG_PRINTLN("Analysis CMD data...");
  if(Rx_Buffer[0] == Read_ID && Rx_Buffer[2] == (cmdLenth - 5))
  {

    if (chkCRC(Rx_Buffer, cmdLenth-2))
    {
      Voltage_data=(((uint32_t)(Rx_Buffer[3]))<<24)|(((uint32_t)(Rx_Buffer[4]))<<16)|(((uint32_t)(Rx_Buffer[5]))<<8)|Rx_Buffer[6];
      Current_data=(((uint32_t)(Rx_Buffer[7]))<<24)|(((uint32_t)(Rx_Buffer[8]))<<16)|(((uint32_t)(Rx_Buffer[9]))<<8)|Rx_Buffer[10]; 
      Power_data=(((uint32_t)(Rx_Buffer[11]))<<24)|(((uint32_t)(Rx_Buffer[12]))<<16)|(((uint32_t)(Rx_Buffer[13]))<<8)|Rx_Buffer[14]; 
      Energy_data=(((uint32_t)(Rx_Buffer[15]))<<24)|(((uint32_t)(Rx_Buffer[16]))<<16)|(((uint32_t)(Rx_Buffer[17]))<<8)|Rx_Buffer[18]; 
      Pf_data=(((uint32_t)(Rx_Buffer[19]))<<24)|(((uint32_t)(Rx_Buffer[20]))<<16)|(((uint32_t)(Rx_Buffer[21]))<<8)|Rx_Buffer[22]; 
      CO2_data=(((uint32_t)(Rx_Buffer[23]))<<24)|(((uint32_t)(Rx_Buffer[24]))<<16)|(((uint32_t)(Rx_Buffer[25]))<<8)|Rx_Buffer[26];       
      Frequency_data=(((uint32_t)(Rx_Buffer[31]))<<24)|(((uint32_t)(Rx_Buffer[32]))<<16)|(((uint32_t)(Rx_Buffer[33]))<<8)|Rx_Buffer[34];
    }
  }
}

bool IM1281B::chkCRC(uint8_t* pucFrame, uint16_t usLen)
{
    uint8_t CRCLo = 0xff;
    uint8_t CRCHi = 0xff;
    int iIndex;
    // get CRC code
    while( usLen-- )
    {
        iIndex = CRCLo ^ *( pucFrame++ );
        CRCLo = ( uint8_t )( CRCHi ^ aucCRCHi[iIndex] );
        CRCHi = aucCRCLo[iIndex];
    }
    // check CRC
    DEBUG_PRINT("Get CRCLo:");
    DEBUG_PRINT(CRCLo);
    DEBUG_PRINT("  ");
    DEBUG_PRINT(Rx_Buffer[cmdLenth-2]);
    DEBUG_PRINT("  Get CRCHi:");
    DEBUG_PRINT(CRCHi);
    DEBUG_PRINT("  ");
    DEBUG_PRINTLN(Rx_Buffer[cmdLenth-1]);
    if (CRCLo == Rx_Buffer[cmdLenth-2] && CRCHi == Rx_Buffer[cmdLenth-1])
    {
      DEBUG_PRINTLN("CRC check success!");
      return true;
    }
    else
    {
      DEBUG_PRINTLN("CRC check faile!");
      return false;
    }
}

void IM1281B::update()
{
  // send message to get data
  clear_CMD_Buffer();
  read_data_message();
  delay(50);
  // get CMD data
  get_CMD_message();
  // analysis power data from CMD data
  analysis_data();
  delay(10);
}

void IM1281B::clear_CMD_Buffer()
{
  while (mySerial->available())
    mySerial->read();
}

void IM1281B::clearPower()
{
  for (size_t i = 0; i < 13; i++)
    mySerial->write(TX_Buffer_clear[i]);
  DEBUG_PRINTLN("Power data reset.");
}

float IM1281B::getVotage(){
  return (float)Voltage_data*0.0001;
}
float IM1281B::getCurrent(){
  return (float)Current_data*0.0001;
}
float IM1281B::getPower(){
  return (float)Power_data*0.0001;
}
float IM1281B::getEnergy(){
  return (float)Energy_data*0.0001;
}
float IM1281B::getPf(){
  return (float)Pf_data*0.001;
}
float IM1281B::getCO2(){
  return (float)CO2_data*0.0001;
}
float IM1281B::getFreq(){
  return (float)Frequency_data*0.01;
}

